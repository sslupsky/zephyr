## soc/arm/atmel_sam0/samd21/Kconfig.series
```kconfig
# Atmel SAMD21 MCU series

# Copyright (c) 2017 Google LLC.
# SPDX-License-Identifier: Apache-2.0

config SOC_SERIES_SAMD21
	bool "Atmel SAMD21 MCU"
	select ARM
	select CPU_CORTEX_M0PLUS
	select SOC_FAMILY_SAM0
	select CPU_CORTEX_M_HAS_SYSTICK
	select CPU_CORTEX_M_HAS_VTOR
	select ASF
	select HAS_SYS_POWER_STATE_SLEEP_1
	select HAS_SYS_POWER_STATE_SLEEP_2
	help
	  Enable support for Atmel SAMD21 Cortex-M0+ microcontrollers.
```
